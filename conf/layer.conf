## conf/layer.conf
```bitbake
# We have a conf and classes directory, add to BBPATH
BBPATH .= ":${LAYERDIR}"

# We have recipes-* directories, add to BBFILES
BBFILES += "${LAYERDIR}/recipes-*/*/*.bb \
            ${LAYERDIR}/recipes-*/*/*.bbappend"

BBFILE_COLLECTIONS += "meta-techdev"
BBFILE_PATTERN_meta-techdev = "^${LAYERDIR}/"
BBFILE_PRIORITY_meta-techdev = "6"

LAYERDEPENDS_meta-techdev = "core"
LAYERSERIES_COMPAT_meta-techdev = "dunfell"
```
